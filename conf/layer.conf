## conf/layer.conf
```bitbake
# We have a conf and classes directory, add to BBPATH
BBPATH .= ":${LAYERDIR}"

# We have recipes-* directories, add to BBFILES
BBFILES += "${LAYERDIR}/recipes-*/*/*.bb \
            ${LAYERDIR}/recipes-*/*/*.bbappend"

BBFILE_COLLECTIONS += "meta-otimofie"
BBFILE_PATTERN_meta-otimofie = "^${LAYERDIR}/"
BBFILE_PRIORITY_meta-otimofie = "6"

LAYERDEPENDS_meta-otimofie = "core"
LAYERSERIES_COMPAT_meta-otimofie = "kirkstone"
```
